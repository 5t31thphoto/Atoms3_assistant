## firmware/sdkconfig.defaults
```kconfig
CONFIG_IDF_TARGET="esp32s3"
CONFIG_ESPTOOLPY_FLASHSIZE_8MB=y
CONFIG_ESPTOOLPY_FLASHMODE_QIO=y
CONFIG_ESPTOOLPY_FLASHFREQ_80M=y
CONFIG_SPIRAM=y
CONFIG_SPIRAM_MODE_OCT=y
CONFIG_SPIRAM_SPEED_80M=y
CONFIG_SPIRAM_USE_MALLOC=y
CONFIG_ESP_MAIN_TASK_STACK_SIZE=16384
CONFIG_FREERTOS_HZ=1000
CONFIG_ESP_CONSOLE_USB_SERIAL_JTAG=y
CONFIG_ESP32_DEFAULT_CPU_FREQ_240=y
CONFIG_ESP_SYSTEM_PANIC_PRINT_REBOOT=y
CONFIG_ESP_TASK_WDT_PANIC=n
CONFIG_ARDUINO_AUTOSTART=n
CONFIG_SR_MN_EN_MULTINET7_QUANT=y
CONFIG_MODEL_IN_FLASH=y
CONFIG_PICOTTS_LANGUAGE_EN_US=y
CONFIG_PICOTTS_RESOURCE_MODE_PARTITION=y
CONFIG_PICOTTS_TA_PARTITION="picotts_ta"
CONFIG_PICOTTS_SG_PARTITION="picotts_sg"
```
